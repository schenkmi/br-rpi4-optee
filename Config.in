## Config.in
```kconfig
source "$BR2_EXTERNAL_RPI4_OPTEE_PATH/package/arm-tf/Config.in"
source "$BR2_EXTERNAL_RPI4_OPTEE_PATH/package/uboot-rpi4/Config.in"
source "$BR2_EXTERNAL_RPI4_OPTEE_PATH/package/rpi4-firmware/Config.in"
```

## configs/rpi4_defconfig
```kconfig
BR2_aarch64=y
BR2_cortex_a72=y
BR2_ARM_FPU_VFPV4=y

BR2_TOOLCHAIN_BUILDROOT_CXX=y

BR2_SYSTEM_DHCP="eth0"

# Linux headers same as kernel, a 4.19 series
BR2_PACKAGE_HOST_LINUX_HEADERS_CUSTOM_4_19=y

BR2_LINUX_KERNEL=y
BR2_LINUX_KERNEL_CUSTOM_TARBALL=y
BR2_LINUX_KERNEL_CUSTOM_TARBALL_LOCATION="$(call github,raspberrypi,linux,64d0a9870ac14d5eb5253f67d984ae348eec1393)/linux-64d0a9870ac14d5eb5253f67d984ae348eec1393.tar.gz"
BR2_LINUX_KERNEL_DEFCONFIG="bcm2711"

# Build the DTB from the kernel sources
BR2_LINUX_KERNEL_DTS_SUPPORT=y
BR2_LINUX_KERNEL_INTREE_DTS_NAME="broadcom/bcm2711-rpi-4-b"
BR2_LINUX_KERNEL_DTB_OVERLAY_SUPPORT=y

BR2_LINUX_KERNEL_NEEDS_HOST_OPENSSL=y

BR2_PACKAGE_RPI_FIRMWARE=y
BR2_PACKAGE_RPI_FIRMWARE_VARIANT_PI4=y

# Required tools to create the SD image
BR2_PACKAGE_HOST_DOSFSTOOLS=y
BR2_PACKAGE_HOST_GENIMAGE=y
BR2_PACKAGE_HOST_MTOOLS=y

# Filesystem / image
BR2_TARGET_ROOTFS_EXT2=y
BR2_TARGET_ROOTFS_EXT2_4=y
BR2_TARGET_ROOTFS_EXT2_SIZE="120M"
# BR2_TARGET_ROOTFS_TAR is not set
BR2_ROOTFS_POST_BUILD_SCRIPT="$(BR2_EXTERNAL_RPI4_OPTEE_PATH)/board/rpi4/post-build.sh"
BR2_ROOTFS_POST_IMAGE_SCRIPT="$(BR2_EXTERNAL_RPI4_OPTEE_PATH)/board/rpi4/post-image.sh"
BR2_ROOTFS_POST_SCRIPT_ARGS="--add-miniuart-bt-overlay --aarch64"

BR2_TARGET_OPTEE_OS=y
BR2_TARGET_OPTEE_OS_CUSTOM_GIT=y
BR2_TARGET_OPTEE_OS_CUSTOM_REPO_URL="https://github.com/schenkmi/optee_os.git"
BR2_TARGET_OPTEE_OS_CUSTOM_REPO_VERSION="7564b630356bf82153325fe10b779d5ea7ea484e"
BR2_TARGET_OPTEE_OS_PLATFORM="rpi4"

BR2_PACKAGE_UBOOT_RPI4=y
BR2_PACKAGE_UBOOT_RPI4_ENVIMAGE_SOURCE="$(BR2_EXTERNAL_RPI4_OPTEE_PATH)/board/rpi4/uboot.env.txt"
BR2_PACKAGE_UBOOT_RPI4_ENVIMAGE_SIZE="0x4000"



BR2_ROOTFS_OVERLAY="$(BR2_EXTERNAL_RPI4_OPTEE_PATH)/board/rpi4/rootfs-overlay"
BR2_TARGET_GENERIC_ROOT_PASSWD="root"
BR2_ROOTFS_DEVICE_TABLE="$(BR2_EXTERNAL_RPI4_OPTEE_PATH)/board/rpi4/device_table.txt"

BR2_PACKAGE_ARM_TF=y
BR2_PACKAGE_ARM_TF_SITE="https://git.trustedfirmware.org/TF-A/trusted-firmware-a.git"
```

## package/rpi4-firmware/Config.in
```kconfig
config BR2_PACKAGE_RPI4_FIRMWARE
	bool "rpi4-firmware"
	help
	  https://github.com/raspberrypi/firmware
```

## package/uboot-rpi4/Config.in
```kconfig
config BR2_PACKAGE_UBOOT_RPI4
	bool "uboot-rpi4"
	help
	  https://github.com/u-boot/u-boot

if BR2_PACKAGE_UBOOT_RPI4
config BR2_PACKAGE_UBOOT_RPI4_ENVIMAGE_SOURCE
	string "Environment image source path"
	help
	  The path of the environment image source

config BR2_PACKAGE_UBOOT_RPI4_ENVIMAGE_SIZE
	string "Environment image size"
	help
	  The size of the environment image
endif
```
